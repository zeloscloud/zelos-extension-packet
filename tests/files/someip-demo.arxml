AUTOSAR XML (schema 00048)
standard types defined: uint16, boolean, uint8, sint16, float32
package /DataTypes
  4 x impl type:
    ModeType: category=VALUE, base-type=uint8, compu {0=OFF, 1=IDLE, 2=DRIVE, 3=FAULT}
    StatusType: category=STRUCTURE
      element speed: category=VALUE, base-type=uint16, compu {phys=raw*0.01; unit km/h}
      element temperature: category=VALUE, base-type=sint16, compu {phys=raw*0.1-40; unit degC}
      element mode: implementation-data-type=ModeType
    SamplesType: category=ARRAY
      element sample: array-size=64, array-size-semantics=VARIABLE-SIZE, implementation-data-type=uint16
    ThresholdType: category=VALUE, base-type=float32, unit=km/h
package /DataTypes/Units
  unit KmPerHour: display-name=km/h
  unit DegC: display-name=degC
package /ServiceInterfaces
  service interface DemoService: major-version=1, minor-version=0
    events:
      data Status: type=StatusType
      data Samples: type=SamplesType
    field Threshold: type=ThresholdType, has-getter=true, has-notifier=true, has-setter=true
    methods:
      operation SetMode
        arg mode: type=ModeType, direction=IN
        arg accepted: type=boolean, direction=OUT
package /Deployments
  someip service interface deployment DemoService_SomeIp: service-interface=DemoService, service-interface-id=4660, service-interface-version={major-version=1, minor-version=0}
    someip event deployment Status: event=Status, event-id=32769
    someip event deployment Samples: event=Samples, event-id=32770
    someip field deployment Threshold: field=Threshold
      get Threshold_get: method-id=2
      notifier Threshold_notify: event-id=32771
      set Threshold_set: method-id=3
    someip method deployment SetMode: method=SetMode, method-id=1
    someip event group eg1: event-group-id=1, event=[Status, Samples, Threshold_notify]
package /TransformationProps
  transformation props set SomeIpProps
    ap someip transformation props Samples16: size-of-array-length-field=2
  transformation props to service interface element mapping set DemoServiceProps
    transformation props to service interface element mapping Samples: event=Samples, transformation-props=Samples16
package /System
  system System: category=SYSTEM_EXTRACT
package /Ethernet
  ethernet cluster DemoEth
    ethernet physical channel DemoEthCh: category=WIRED, comm-connectors=EthConn
      network endpoint NE_Server: network-endpoint-addresses=ipv-4-configuration={ipv-4-address=127.0.0.1, ipv-4-address-source=FIXED, network-mask=255.0.0.0}
      network endpoint NE_SdMulticast: network-endpoint-addresses=ipv-4-configuration={ipv-4-address=224.224.224.245, ipv-4-address-source=FIXED, network-mask=255.0.0.0}
      so-ad-config:
        socket address SA_DemoService: connector=EthConn
          application endpoint SA_DemoService_AE: network-endpoint=NE_Server, tp-configuration=udp-tp=udp-tp-port=port-number=30509
        socket address SA_Sd: multicast-connector=EthConn
          application endpoint SA_Sd_AE: network-endpoint=NE_SdMulticast, tp-configuration=udp-tp=udp-tp-port=port-number=30490
package /Ecus
  ecu instance DemoServer
    ethernet communication controller EthCtrl
      coupling port EthCtrl_CouplingPort
    ethernet communication connector EthConn: category=WIRED, comm-controller=EthCtrl
package /ServiceInstances
  service instance collection set Services
    provided service instance DemoService_1: major-version=1, instance-identifier=1, local-unicast-addresss=SA_DemoService_AE, minor-version=0, service-identifier=4660
      event handler EH1: event-group-identifier=1

AUTOSAR XML (schema 00048)
standard types defined: uint16, boolean, uint8, sint16, float32
package /DataTypes
  4 x impl type:
    ModeType: category=VALUE, base-type=uint8, compu {0=OFF, 1=IDLE, 2=DRIVE, 3=FAULT}
    StatusType: category=STRUCTURE
      element speed: category=VALUE, base-type=uint16, compu {phys=raw*0.01; unit km/h}
      element temperature: category=VALUE, base-type=sint16, compu {phys=raw*0.1-40; unit degC}
      element mode: implementation-data-type=ModeType
    SamplesType: category=ARRAY
      element sample: array-size=64, array-size-semantics=VARIABLE-SIZE, implementation-data-type=uint16
    ThresholdType: category=VALUE, base-type=float32, unit=km/h
package /DataTypes/Units
  unit KmPerHour: display-name=km/h
  unit DegC: display-name=degC
  unit Nm: display-name=Nm
package /ServiceInterfaces
  service interface DemoService: major-version=1, minor-version=0
    events:
      data Status: type=StatusType
      data Samples: type=SamplesType
    field Threshold: type=ThresholdType, has-getter=true, has-notifier=true, has-setter=true
    methods:
      operation SetMode
        arg mode: type=ModeType, direction=IN
        arg accepted: type=boolean, direction=OUT
package /Deployments
  someip service interface deployment DemoService_SomeIp: service-interface=DemoService, service-interface-id=4660, service-interface-version={major-version=1, minor-version=0}
    someip event deployment Status: event=Status, event-id=32769
    someip event deployment Samples: event=Samples, event-id=32770
    someip field deployment Threshold: field=Threshold
      get Threshold_get: method-id=2
      notifier Threshold_notify: event-id=32771
      set Threshold_set: method-id=3
    someip method deployment SetMode: method=SetMode, method-id=1
    someip event group eg1: event-group-id=1, event=[Status, Samples, Threshold_notify]
package /TransformationProps
  transformation props set SomeIpProps
    ap someip transformation props Samples16: size-of-array-length-field=2
  transformation props to service interface element mapping set DemoServiceProps
    transformation props to service interface element mapping Samples: event=Samples, transformation-props=Samples16
package /System
  system System: category=SYSTEM_EXTRACT
package /Ethernet
  ethernet cluster DemoEth
    ethernet physical channel DemoEthCh: category=WIRED, comm-connectors=EthConn
      pdu triggering PT_DemoPdu: pdu=DemoPdu
      network endpoint NE_Server: network-endpoint-addresses=ipv-4-configuration={ipv-4-address=127.0.0.1, ipv-4-address-source=FIXED, network-mask=255.0.0.0}
      network endpoint NE_SdMulticast: network-endpoint-addresses=ipv-4-configuration={ipv-4-address=224.224.224.245, ipv-4-address-source=FIXED, network-mask=255.0.0.0}
      network endpoint NE_Client: network-endpoint-addresses=ipv-4-configuration={ipv-4-address=127.0.0.2, ipv-4-address-source=FIXED, network-mask=255.0.0.0}
      so-ad-config:
        socket connection bundle DemoPduBundle: socket-connection{client-port=SA_DemoPduClient, pdus=socket-connection-ipdu-identifier={header-id=257, pdu-triggering=PT_DemoPdu}}, server-port=SA_DemoPdu
        4 x socket address:
          SA_DemoService: connector=EthConn
            application endpoint SA_DemoService_AE: network-endpoint=NE_Server, tp-configuration=udp-tp=udp-tp-port=port-number=30509
          SA_Sd: multicast-connector=EthConn
            application endpoint SA_Sd_AE: network-endpoint=NE_SdMulticast, tp-configuration=udp-tp=udp-tp-port=port-number=30490
          SA_DemoPdu: connector=EthConn
            application endpoint SA_DemoPdu_AE: network-endpoint=NE_Server, tp-configuration=udp-tp=udp-tp-port=port-number=30600
          SA_DemoPduClient
            application endpoint SA_DemoPduClient_AE: network-endpoint=NE_Client, tp-configuration=udp-tp=udp-tp-port=port-number=40001
package /Ecus
  ecu instance DemoServer
    ethernet communication controller EthCtrl
      coupling port EthCtrl_CouplingPort
    ethernet communication connector EthConn: category=WIRED, comm-controller=EthCtrl
package /ServiceInstances
  service instance collection set Services
    provided service instance DemoService_1: major-version=1, instance-identifier=1, local-unicast-addresss=SA_DemoService_AE, minor-version=0, service-identifier=4660
      event handler EH1: event-group-identifier=1
package /Pdus
  pdu DemoPdu: length=8
    signal torque: start 24, 16 bit, little-endian, data-type-policy=OVERRIDE, base-type=sint16, end-to-end-transformation-i-signal-props{transformer=E2E_P05, data-ids=291, data-length=64}, compu {phys=raw*0.1}, unit=Nm, transfer-property=PENDING
    signal rpm: start 40, 16 bit, little-endian, data-type-policy=OVERRIDE, base-type=uint16, transfer-property=PENDING
    signal state: start 56, 8 bit, little-endian, data-type-policy=OVERRIDE, base-type=uint8, compu {0=OFF, 1=ON}, transfer-property=PENDING
package /Transformers
  data transformation set E2E
    transformation technology E2E_P05:
      buffer-properties={header-length=24, in-place=true}
      has-internal-state=true
      needs-original-data=false
      protocol=E2E
      end-to-end-transformation-description{max-delta-counter=2, max-error-state-init=0, max-error-state-invalid=0, max-error-state-valid=0, max-no-new-or-repeated-data=2, min-ok-state-init=1, min-ok-state-invalid=1, min-ok-state-valid=1, offset=0, profile-behavior=R-4--2, profile-name=PROFILE_05, upper-header-bits-to-shift=0, window-size-init=3, window-size-invalid=3, window-size-valid=3}
      transformer-class=SAFETY
      version=1.0.0
